## conf/machine/rk3588-toybrick-opengl.conf
```bitbake
# Copyright (c) 2021, Rockchip Electronics Co., Ltd
# Released under the MIT license (see COPYING.MIT for the terms)

#@TYPE: Machine
#@NAME: RK3588 EVB

require conf/machine/include/rk3588.inc

KERNEL_DEVICETREE = "rockchip/rk3588-toybrick-x0-linux.dtb"

UBOOT_MACHINE = "rk3588_defconfig"

RK_WIFIBT_RRECOMMENDS = " \
	rkwifibt-firmware-ap6275p-wifi \
	rkwifibt-firmware-ap6275-bt \
	brcm-tools \
"

PREFERRED_PROVIDER_virtual/libgl = "mesa"
PREFERRED_PROVIDER_virtual/mesa = "mesa"
PREFERRED_PROVIDER_virtual/egl = "mesa"
PREFERRED_PROVIDER_virtual/libgles1 = "mesa"
PREFERRED_PROVIDER_virtual/libgles2 = "mesa"
PREFERRED_PROVIDER_virtual/libgles3 = "mesa"
PREFERRED_PROVIDER_virtual/libopencl = "mesa"
PREFERRED_PROVIDER_virtual/libgbm = "mesa"
DEPENDS:append:pn-mesa-gl = " mesa"

PREFERRED_PROVIDER_virtual/kernel = "linux-rockchip-opengl"
PREFERRED_VERSION_linux-rockchip-opengl = "6.1%"

PREFERRED_PROVIDER_virtual/xserver ?= "xserver-xorg"
XSERVER ?= " \
        xserver-xorg \
        xf86-video-modesetting \
        xserver-xorg-module-exa \
        xserver-xorg-extension-glx \
"
IMAGE_FEATURES:append = " \
        debug-tweaks dev-pkgs \
        tools-sdk package-management \
        hwcodecs nfs-server \
        ssh-server-openssh \
"
LICENSE_FLAGS_ACCEPTED:append = "commercial"
DISTRO_FEATURES:append = " x11 opengl"
DISTRO_FEATURES:append = " nfs ldconfig gobject-introspection-data zeroconf polkit"
DISTRO_FEATURES:remove = "wayland"

IMAGE_FSTYPES:append = " wic ext4"
WKS_FILE = "rockchip.wks.in"
```
